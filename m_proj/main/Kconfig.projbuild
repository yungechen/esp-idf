## m_proj/main/Kconfig.projbuild
```kconfig
menu "My Application Settings"
    source "../main/app.kconfig"
    source "../bsp/bsp.kconfig"
endmenu
```

## m_proj/sdkconfig.defaults
```kconfig
# ESP32-P4 v1.0 (eco2 early silicon, rev < 3.0)
CONFIG_ESP32P4_SELECTS_REV_LESS_V3=y
CONFIG_ESP32P4_REV_MIN_100=y

# 16MB external flash (detected by esptool)
CONFIG_ESPTOOLPY_FLASHSIZE_16MB=y

# v1.x silicon max CPU freq is 360 MHz (400 MHz requires rev >= 3.0)
CONFIG_ESP_DEFAULT_CPU_FREQ_MHZ_360=y
```

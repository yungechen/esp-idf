## proj_s31/main/Kconfig
```kconfig
menu "main"

config MAIN_ENABLE
    bool "Enable main"
    default y

if MAIN_ENABLE

    config APP_INIT_ETHERNET
        bool "Initialize Ethernet at startup"
        default n
        help
            If enabled, app_main() initializes the Ethernet driver (thirdparty/ethernet_init
            + yt8531) and registers ethernet console commands. Disable to boot without
            touching EMAC/PHY.

    config APP_DISABLE_ETHERNET_INIT_COMPONENT
        bool
        default y if !APP_INIT_ETHERNET
        select ETHERNET_INIT_OVERRIDE_DISABLE if !APP_INIT_ETHERNET

source "$IDF_PATH/proj_s31/main/common/Kconfig"
source "$IDF_PATH/proj_s31/main/bsp/Kconfig"

endif
endmenu
```

## proj_s31/main/bsp/Kconfig
```kconfig
menu "bsp"

config BSP_ENABLE
    bool "Enable bsp"
    default y

if BSP_ENABLE

    menu "FTM_CONFIG"
    
    config FTM_CONFIG_ENABLE
        bool "Enable FTM_CONFIG"
        depends on ESP_WIFI_FTM_ENABLE && ESP_WIFI_FTM_INITIATOR_SUPPORT
        default y

    if FTM_CONFIG_ENABLE

        config FTM_RANGING_PERIOD_SEC
            int "Ranging period (sec)"
            range 1 60
            default 10
        
        config FTM_RANGING_FRM_COUNT
            int "Ranging frame count (16/24/32/64)"
            range 16 64
            default 32
        
        config FTM_RANGING_BURST_PERIOD
            int "Ranging burst period"
            range 1 10
            default 2
        
        config FTM_RANGING_MAX_FAIL
            int "Ranging max fail"
            range 1 10
            default 3
    endif
    endmenu

    source "$IDF_PATH/proj_s31/main/bsp/bspaudio/Kconfig"

endif
endmenu
```

## proj_s31/main/bsp/bspaudio/Kconfig
```kconfig
menu "BSP_AUDIO"

config BSP_AUDIO_ENABLE
    bool "Enable BSP_AUDIO"
    default y

if BSP_AUDIO_ENABLE

    config BSP_AUDIO_I2C_NUM
        int "I2C NUM"
        range 0 1
        default 0

    config BSP_AUDIO_I2C_SDA_PIN
        int "I2C SDA PIN"
        range 0 SOC_GPIO_OUT_RANGE_MAX
        default 21

    config BSP_AUDIO_I2C_SCL_PIN
        int "I2C SCL PIN"
        range 0 SOC_GPIO_OUT_RANGE_MAX
        default 22

    config BSP_AUDIO_I2S_NUM
        int "I2S NUM"
        range 0 1
        default 0

    config BSP_AUDIO_I2S_MCLK_PIN
        int "I2S MCLK PIN"
        range 0 SOC_GPIO_OUT_RANGE_MAX
        default 25

    config BSP_AUDIO_I2S_SCLK_PIN
        int "I2S SCLK (BCLK) PIN"
        range 0 SOC_GPIO_OUT_RANGE_MAX
        default 25

    config BSP_AUDIO_I2S_ASDOUT_PIN
        int "I2S ASDOUT PIN (codec ADC -> MCU DIN)"
        range 0 SOC_GPIO_IN_RANGE_MAX
        default 25

    config BSP_AUDIO_I2S_LRCK_PIN
        int "I2S LRCK (WS) PIN"
        range 0 SOC_GPIO_OUT_RANGE_MAX
        default 26

    config BSP_AUDIO_I2S_DSDIN_PIN
        int "I2S DSDIN PIN (MCU DOUT -> codec DAC)"
        range 0 SOC_GPIO_OUT_RANGE_MAX
        default 27

    config BSP_AUDIO_MIC_GAIN
        int "MIC GAIN"
        range 0 31
        default 30

    config BSP_AUDIO_PA_CTRL_PIN
        int "PA CTRL PIN (-1 to disable)"
        range -1 SOC_GPIO_OUT_RANGE_MAX
        default 28

    config BSP_AUDIO_MCLK_MULTIPLE
        int "MCLK MULTIPLE"
        range 1 1024
        default 384

    config BSP_AUDIO_SAMPLE_RATE
        int "SAMPLE RATE"
        range 8000 192000
        default 16000

    config BSP_AUDIO_VOICE_VOLUME
        int "VOICE VOLUME"
        range 0 100
        default 50

endif
endmenu
```

## proj_s31/main/common/Kconfig
```kconfig
menu "common"

    config COMMON_ENABLE
        bool "Enable common"
        default y

if COMMON_ENABLE

config FTP_SERVER_SUPPORT
    bool "Enable FTP server support"
    default n
    help
        Enable FTP server support

endif

endmenu
```
